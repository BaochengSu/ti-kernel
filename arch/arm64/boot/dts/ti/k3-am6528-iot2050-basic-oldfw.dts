// SPDX-License-Identifier: GPL-2.0
/*
 * (C) Copyright 2018-2020 Siemens AG
 */

/dts-v1/;

#include "k3-am65-iot2050.dtsi"
#include "k3-am6528-iot2050-basic.dtsi"
#include "k3-am65-iot2050-oldfw.dtsi"

/* Compat support for bootloader V01.00.00.1 */

&ospi0 {
	clocks = <&k3_clks 55 5>;
	assigned-clocks = <&k3_clks 55 5>;
	assigned-clock-parents = <&k3_clks 55 7>;
	power-domains = <&k3_pds 55 TI_SCI_PD_EXCLUSIVE>;
};

&ospi1 {
	clocks = <&k3_clks 55 16>;
	power-domains = <&k3_pds 55 TI_SCI_PD_EXCLUSIVE>;
};
