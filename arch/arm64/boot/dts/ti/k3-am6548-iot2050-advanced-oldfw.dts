// SPDX-License-Identifier: GPL-2.0
/*
 * (C) Copyright 2018-2020 Siemens AG
 */

/dts-v1/;

#include "k3-am65-iot2050.dtsi"
#include "k3-am6548-iot2050-advanced.dtsi"
#include "k3-am65-iot2050-oldfw.dtsi"
